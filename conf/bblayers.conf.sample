## conf/bblayers.conf.sample
```bitbake
# LAYER_CONF_VERSION is increased each time build/conf/bblayers.conf
# changes incompatibly
LCONF_VERSION = "6"

BBPATH = "${TOPDIR}"
BBFILES ?= ""

BBLAYERS ?= " \
  ##COREBASE##/meta \
  ##COREBASE##/meta-yocto \
  ##COREBASE##/meta-openembedded/meta-oe \
  ##COREBASE##/meta-openembedded/meta-networking \
  ##COREBASE##/meta-openembedded/meta-python \
  ##COREBASE##/meta-qt5 \
  ##COREBASE##/meta-signum \
  ##COREBASE##/meta-signum/meta-rpi \
  ##COREBASE##/meta-raspberrypi \
  "

BBLAYERS_NON_REMOVABLE ?= " \
  ##OEROOT##/meta \
  ##OEROOT##/meta-yocto \
  "
```

## conf/layer.conf
```bitbake
# We have a conf and classes directory, add to BBPATH
BBPATH .= ":${LAYERDIR}"

# We have recipes-* directories, add to BBFILES
BBFILES += "\
 ${LAYERDIR}/recipes-*/*/*.bb \
 ${LAYERDIR}/recipes-*/*/*.bbappend \
"

BBFILE_COLLECTIONS += "signum"
BBFILE_PATTERN_signum = "^${LAYERDIR}/"
BBFILE_PRIORITY_signum = "6"

LAYERDEPENDS_signum = "qt5-layer"
```

## meta-rpi/conf/machine/raspberrypi2.conf
```bitbake
#@TYPE: Machine
#@NAME: RaspberryPi 2 Development Board
#@DESCRIPTION: Machine configuration for the RaspberryPi 2

DEFAULTTUNE ?= "cortexa7thf-neon-vfpv4"

require conf/machine/include/tune-cortexa7.inc
include conf/machine/include/rpi-base.inc

# TODO: make rpi-ft5406-overlay.dtb conditional
KERNEL_DEVICETREE = "\
 bcm2708-rpi-b-plus.dtb \
 bcm2708-rpi-b.dtb \
 bcm2709-rpi-2-b.dtb \
 overlays/hifiberry-amp-overlay.dtb \
 overlays/hifiberry-dac-overlay.dtb \
 overlays/hifiberry-dacplus-overlay.dtb \
 overlays/hifiberry-digi-overlay.dtb \
 overlays/iqaudio-dac-overlay.dtb \
 overlays/iqaudio-dacplus-overlay.dtb \
 overlays/lirc-rpi-overlay.dtb \
 overlays/pps-gpio-overlay.dtb \
 overlays/rpi-ft5406-overlay.dtb \
 overlays/w1-gpio-overlay.dtb \
 overlays/w1-gpio-pullup-overlay.dtb \
"
```
